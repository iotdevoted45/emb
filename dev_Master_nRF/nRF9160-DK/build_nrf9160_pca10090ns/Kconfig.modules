## dev_Master_nRF/nRF9160-DK/build_nrf9160_pca10090ns/Kconfig.modules
```kconfig
osource "E:/Nordic/ncs/nrf/Kconfig.nrf"

osource "E:/Nordic/ncs/bootloader/mcuboot/zephyr/Kconfig"

osource "E:/Nordic/ncs/nrfxlib/Kconfig.nrfxlib"
```
